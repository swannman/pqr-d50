## esp32/pqr-d50-bridge/sdkconfig.defaults
```kconfig
# Target
CONFIG_IDF_TARGET="esp32s3"

# Native USB host (the S3's OTG controller)
CONFIG_USB_HOST_CONTROL_TRANSFER_MAX_SIZE=1024

# TLS: use the bundled root CA store for Grafana Cloud HTTPS
CONFIG_MBEDTLS_CERTIFICATE_BUNDLE=y
CONFIG_ESP_TLS_USING_MBEDTLS=y

# 16MB flash (N16)
CONFIG_ESPTOOLPY_FLASHSIZE_16MB=y
CONFIG_PARTITION_TABLE_SINGLE_APP_LARGE=y

# 8MB octal PSRAM (R8)
CONFIG_ESP32S3_SPIRAM_SUPPORT=y
CONFIG_SPIRAM_MODE_OCT=y
```
